## sdkconfig.defaults
```kconfig
# Copyright 2026 Morse Micro
#
# SPDX-License-Identifier: Apache-2.0

CONFIG_PARTITION_TABLE_SINGLE_APP_LARGE=y



CONFIG_MM_RESET_N=1
CONFIG_MM_WAKE=2
CONFIG_MM_BUSY=5
CONFIG_MM_SPI_SCK=7
CONFIG_MM_SPI_MOSI=9
CONFIG_MM_SPI_MISO=8
CONFIG_MM_SPI_CS=4
CONFIG_MM_SPI_IRQ=3
CONFIG_HALOW_COUNTRY_CODE="US"
```
